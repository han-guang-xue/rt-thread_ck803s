## code/rt-thread/components/utilities/Kconfig
```kconfig
menu "Utilities"

if RT_HAVING_LOGTRACE
    config RT_USING_LOGTRACE
        bool "Enable log trace"
        default n
endif

if RT_USING_LOGTRACE
    config LOG_TRACE_MAX_SESSION
        int "Maximal number of session"
        default 16

    choice
        prompt "The default level of log"
        default LOG_TRACE_USING_LEVEL_INFO

        config LOG_TRACE_USING_LEVEL_NOTRACE
            bool "No trace"

        config LOG_TRACE_USING_LEVEL_ERROR
            bool "Only error log"

        config LOG_TRACE_USING_LEVEL_WARNING
            bool "Warning log"

        config LOG_TRACE_USING_LEVEL_INFO
            bool "Information log"

        config LOG_TRACE_USING_LEVEL_VERBOSE
            bool "Verbose log"

        config LOG_TRACE_USING_LEVEL_DEBUG
            bool "All debug log"
    endchoice

    config LOG_TRACE_USING_MEMLOG
        bool "Enable memory log for logtrace"
        default n
        help
            Enable memory log for logtrace, then the logs in log_trace
            will be printed out in idle thread hook function.

            Please make sure the idle hook is not used.
			
endif

if RT_HAVING_RYM
    config RT_USING_RYM
        bool "Enable Ymodem"
        default n
endif

config RT_USING_UTEST
    bool "Enable utest (RT-Thread test framework)"
    default n

    if RT_USING_UTEST
        config UTEST_THR_STACK_SIZE
            int "The utest thread stack size"
            default 4096
        config UTEST_THR_PRIORITY
            int "The utest thread priority"
            default 20
    endif

endmenu
```

## code/rt-thread/libcpu/Kconfig
```kconfig
config ARCH_ARM
    bool

config ARCH_ARM_ARM9
    bool
    select ARCH_ARM
	
config ARCH_CSKY
    bool
```

## code/rt-thread/packages/Kconfig
```kconfig
menu "RT-Thread local packages"

source "$RTT_DIR/packages/mbedtls-2.6.0/Kconfig"
source "$RTT_DIR/packages/netutils-1.0.0/Kconfig"
source "$RTT_DIR/packages/webclient-2.0.1/Kconfig"
source "$RTT_DIR/packages/webnet-2.0.0/Kconfig"

endmenu
```

## code/rt-thread/packages/webclient-2.0.1/Kconfig
```kconfig
menuconfig PKG_USING_WEBCLIENT
    bool "WebClient: A HTTP/HTTPS Client for RT-Thread"
    default n
    select RT_USING_LIBC

if PKG_USING_WEBCLIENT

    if !PKG_USING_WEBCLIENT_V100
    
        config WEBCLIENT_USING_SAMPLES
            bool "Enable webclient GET/POST samples"
            default n
            
    endif

    if PKG_USING_WEBCLIENT_V201
    
        config WEBCLIENT_USING_TLS
            bool "Enable support tls protocol"
            select PKG_USING_MBEDTLS
            select MBEDTLS_USING_CRYPTO
            select MBEDTLS_USING_X509
            select MBEDTLS_USING_TLS
            default n
    
    endif 

    choice

        prompt "Version"
        help
            Select the webclient version
        default PKG_USING_WEBCLIENT_V201

        config PKG_USING_WEBCLIENT_V201
            bool "v2.0.1"

    endchoice

    config PKG_WEBCLIENT_VER
       string
       default "v2.0.1"    if PKG_USING_WEBCLIENT_V201

endif
```

## code/rt-thread/packages/webnet-2.0.0/Kconfig
```kconfig
# Kconfig file for package webnet
menuconfig PKG_USING_WEBNET
    bool "WebNet: A lightweight, customizable, embeddable Web Server for RT-Thread"
    default n
    select RT_USING_SAL
    select RT_USING_LWIP
    select SAL_USING_POSIX
    select RT_USING_DFS
    select RT_USING_DFS_ROMFS

if PKG_USING_WEBNET
	
    config WEBNET_PORT
        int "Server listen port"
	default 443 if WEBNET_USING_TLS
	default 80  if !WEBNET_USING_TLS
        range 0 65535
        
    config WEBNET_CONN_MAX
        int "Maximum number of server connections"
        default 16
        range 1 100
        
    config WEBNET_ROOT
        string "Default server root directory, don't modify"
        default "/rom/webnet"
    
    menu "Select supported modules"
    
        config WEBNET_USING_LOG
            bool "LOG: Enable output log support"
            default n
        
        config WEBNET_USING_AUTH
            bool "AUTH: Enable basic HTTP authentication support"
            default n

	config WEBNET_USING_TLS
            bool "TLS: Enable HTTPS support"
            select PKG_USING_MBEDTLS
            select MBEDTLS_USING_CRYPTO
            select MBEDTLS_USING_X509
            select MBEDTLS_USING_TLS
            default n		
        
        config WEBNET_USING_CGI
            bool "CGI: Enable Common Gateway Interface support"
            default n
        
        config WEBNET_USING_ASP
            bool "ASP: Enable Active Server Pages support"
            default n
        
        config WEBNET_USING_SSI
            bool "SSI: Enable Server Side Includes support"
            default n        
        
        config WEBNET_USING_INDEX
            bool "INDEX: Enable list all the file in the directory support"
            default n
            
        config WEBNET_USING_ALIAS
            bool "ALIAS: Enable alias support"
            default n
        
        config WEBNET_USING_DAV
            bool "DAV: Enable Web-based Distributed Authoring and Versioning support"
            default n
        
        config WEBNET_USING_UPLOAD
            bool "UPLOAD: Enable upload file support"
            select RT_USING_DFS_RAMFS
            default n
        
        config WEBNET_USING_GZIP
            bool "GZIP: Enable compressed file support by GZIP"
            default n
        
        config WEBNET_CACHE_LEVEL
            int "CACHE: Configure cache level(0:disable 1:use Last-Modified 2:use Cache-Control)" 
            default 0
            range 0 2
            
        if WEBNET_CACHE_LEVEL = 2 
            
            config WEBNET_CACHE_MAX_AGE
            int "Cache-Control time in seconds"
            default 1800
            
        endif
        
    endmenu
    
    config WEBNET_USING_SAMPLES
        bool "Enable webnet samples"
        default n
        select WEBNET_USING_ASP
        select WEBNET_USING_AUTH
        select WEBNET_USING_CGI
        select WEBNET_USING_INDEX
        select WEBNET_USING_ALIAS
        select WEBNET_USING_SSI
        select WEBNET_USING_UPLOAD
    
    choice
        prompt "Version"
        help
            Select the webnet version
        config PKG_USING_WEBNET_V200
            bool "v2.0.0"
            default y
    endchoice
          
    config PKG_WEBNET_VER
       string
       default "v2.0.0"    if PKG_USING_WEBNET_V200

endif
```
