## code/rt-thread/bsp/t6x0/app/Kconfig
```kconfig
mainmenu "RT-Thread Configuration"

config $BSP_DIR
    string
    option env="BSP_ROOT"
    default "."

config $RTT_DIR
    string
    option env="RTT_ROOT"
    default "../../.."

# you can change the RTT_ROOT default "../.." to your rtthread_root,
# example : default "F:/git_repositories/rt-thread"

config $PKGS_DIR
    string
    option env="PKGS_ROOT"
    default "../../../packages"

source "$BSP_DIR/../drivers/Kconfig"

if RT_USING_T660 || RT_USING_T680    
    source "$RTT_DIR/Kconfig"
    source "$PKGS_DIR/Kconfig"
endif
```

## code/rt-thread/bsp/t6x0/drivers/Kconfig
```kconfig
menu "T6X0 Soc hardware resource"
    choice
    default RT_USING_NONE
        prompt "Soc hardware select"
        help
            Select the mbedtls version

        config RT_USING_T660
            bool "T660 Soc"
            default n
            
            if RT_USING_T660
                menu "T660 setting"
                    config RT_HAVING_GMAC
                        bool "select hardware module->gmac"
                        default y
                        
                        if RT_HAVING_GMAC
                            config RT_USING_ETH1
                                bool "select gmac:eth1"
                                select RT_USING_LWIP
                                default y
                        endif
                        
                    config RT_HAVING_ATA
                        bool "select hardware module->ata"
                        default y            
                        
                    config RT_HAVING_CRYPTO
                        bool "select hardware module->crypto"
                        default y
                        
                    config RT_HAVING_TIMER
                        bool "select hardware module->timer"
                        default y            
                        
                    config RT_HAVING_CPUTIME
                        bool "select hardware module->cpu timer"
                        default y                                    
                
                    config RT_HAVING_I2C
                        bool "select hardware module->i2c"
                        default y
                        
                        if RT_HAVING_I2C
                            config RT_USING_EEPROM
                                bool "select eeprom device driver"
                                select RT_USING_DEVICE
                                default y
                        endif
            
                    config RT_HAVING_UART
                        bool "select hardware module->uart"
                        default y
                        
                         if RT_HAVING_UART
                            config RT_USING_UART1
                                bool "select UART:1"
                                select RT_USING_DEVICE
                                default y
                        endif
                    
                    config RT_HAVING_WDT
                        bool "select hardware module->wdt"
                        default y
            
                    config RT_HAVING_SPI
                        bool "select hardware module->spi"
                        default y
                        
                        if RT_HAVING_SPI
                            config RT_USING_ADC
                                bool "select adc device driver"
                                select RT_USING_DEVICE
                                default y
                        endif
                        
                    config RT_HAVING_GPIO
                        bool "select hardware module->gpio"
                        default y
                    
                endmenu
            endif
            
        config RT_USING_T680
            bool "T680 Soc"
            default n
            
            if RT_USING_T680
                menu "T680 setting"
                    config RT_HAVING_GMAC
                        bool "select hardware module->gmac"
                        default y
                        
                        if RT_HAVING_GMAC
                            config RT_USING_ETH0
                                bool "select gmac:eth0"
                                select RT_USING_LWIP
                                default y
                            config RT_USING_ETH1
                                bool "select gmac:eth1"
                                select RT_USING_LWIP
                                default y
                        endif
                        
                    config RT_HAVING_ATA
                        bool "select hardware module->ata"
                        default y            
                        
                    config RT_HAVING_CRYPTO
                        bool "select hardware module->crypto"
                        default y
                        
                    config RT_HAVING_TIMER
                        bool "select hardware module->timer"
                        default y

                    config RT_HAVING_CPUTIME
                        bool "select hardware module->cpu timer"
                        default y            
                
                    config RT_HAVING_I2C
                        bool "select hardware module->i2c"
                        default y
                        
                        if RT_HAVING_I2C
                            config RT_USING_EEPROM
                                bool "select eeprom device driver"
                                select RT_USING_DEVICE
                                default y
                        endif
            
                    config RT_HAVING_UART
                        bool "select hardware module->uart"
                        default y
                        
                         if RT_HAVING_UART
                            config RT_USING_UART1
                                bool "select UART:1"
                                select RT_USING_DEVICE
                                default y
                        endif
                    
                    config RT_HAVING_WDT
                        bool "select hardware module->wdt"
                        default y
            
                    config RT_HAVING_SPI
                        bool "select hardware module->spi"
                        default y
                        
                        if RT_HAVING_SPI
                            config RT_USING_ADC
                                bool "select adc device driver"
                                select RT_USING_DEVICE
                                default y
                        endif
                        
                    config RT_HAVING_GPIO
                        bool "select hardware module->gpio"
                        default y
                            
                endmenu
            endif
            
        config RT_USING_NONE
            bool "No Soc"
            default y            
    endchoice
    
endmenu
```

## code/rt-thread/components/drivers/Kconfig
```kconfig
menu "Device Drivers"

config RT_USING_DEVICE_IPC
    bool "Using device drivers IPC"
    default y

if RT_USING_DEVICE_IPC
    config RT_PIPE_BUFSZ
        int "Set pipe buffer size"
        default 512
endif

if RT_HAVING_CRYPTO
    config RT_USING_CRYPTO
        bool "Using crypto device drivers"
        select RT_USING_DEVICE
        default y
endif    

if RT_HAVING_ATA
    config RT_USING_ATA
        bool "Using ATA device drivers"
        select RT_USING_DEVICE
        default y
endif

if RT_HAVING_ACLINK
    config RT_USING_ACLINK
        bool "Using aclink module for dual-core communication"
        select RT_USING_DEVICE_IPC
        default y
endif    

if RT_HAVING_UART
    config RT_USING_SERIAL
        bool "Using serial device drivers"
        select RT_USING_DEVICE_IPC
        select RT_USING_DEVICE
        default y
endif    

if RT_HAVING_TIMER
    config RT_USING_HWTIMER
        bool "Using hardware timer device drivers"
        select RT_USING_DEVICE
        default n
endif

if RT_HAVING_CPUTIME
    config RT_USING_CPUTIME
        bool "Enable CPU time for high resolution clock counter"
        default n
        help
            When enable this option, the BSP should provide a rt_clock_cputime_ops
            for CPU time by:
            const static struct rt_clock_cputime_ops _ops = {...};
            clock_cpu_setops(&_ops);
    
            Then user can use high resolution clock counter with:
    
            ts1 = clock_cpu_gettime();
            ts2 = clock_cpu_gettime();
    
            /* and get the ms of delta tick with API: */
            ms_tick = clock_cpu_millisecond(t2 - t1);
            us_tick = clock_cpu_microsecond(t2 - t1);
    
            /* cpu time clock src */
            Use the cycle counter in SCU module(=AHB clock) for CPU time.
            
endif

if RT_HAVING_I2C
    config RT_USING_I2C
        bool "Using I2C device drivers"
        select RT_USING_DEVICE
        default n
endif

if RT_USING_I2C
    config RT_USING_I2C_BITOPS
        bool "Use GPIO to simulate I2C"
        default y
endif

if RT_HAVING_GPIO
    config RT_USING_PIN
        bool "Using generic GPIO device drivers"
        select RT_USING_DEVICE
        default y
endif

if RT_HAVING_PWM
    config RT_USING_PWM
        bool "Using PWM device drivers"
        select RT_USING_DEVICE
        default n
endif

if RT_HAVING_MTD_NOR
    config RT_USING_MTD_NOR
        bool "Using MTD Nor Flash device drivers"
        select RT_USING_DEVICE
        default n
endif

if RT_HAVING_MTD_NAND
    config RT_USING_MTD_NAND
        bool "Using MTD Nand Flash device drivers"
        select RT_USING_DEVICE
        default n
    
        if RT_USING_MTD_NAND
        config RT_MTD_NAND_DEBUG
            bool "Enable MTD Nand operations debug information"
            default n
        endif
endif

config RT_USING_RTC
    bool "Using RTC device drivers"
    select RT_USING_DEVICE
    default n

    if RT_USING_RTC
    config RT_USING_SOFT_RTC
        bool "Using software simulation RTC device"
        default n
    config RTC_SYNC_USING_NTP
        bool "Using NTP auto sync RTC time"
        select PKG_USING_NETUTILS
        select PKG_NETUTILS_NTP
        default n
        
        if RTC_SYNC_USING_NTP
        config RTC_NTP_FIRST_SYNC_DELAY
            int "NTP first sync delay time(second) for network connect"
            default 30
        config RTC_NTP_SYNC_PERIOD
            int "NTP auto sync period(second)"
            default 3600
       endif
    endif

if RT_HAVING_SDIO
    config RT_USING_SDIO
        bool "Using SD/MMC device drivers"
        select RT_USING_DEVICE
        default n
    
        if RT_USING_SDIO
            config RT_SDIO_STACK_SIZE
                int "The stack size for sdio irq thread"
                default 512
    
            config RT_SDIO_THREAD_PRIORITY
                int "The priority level value of sdio irq thread"
                default 15
    
            config RT_MMCSD_STACK_SIZE
                int "The stack size for mmcsd thread"
                default 1024
    
            config RT_MMCSD_THREAD_PREORITY
                int "The priority level value of mmcsd thread"
                default 22
    
            config RT_MMCSD_MAX_PARTITION
                int "mmcsd max partition"
                default 16
        endif
endif

if RT_HAVING_SPI
    config RT_USING_SPI
        bool "Using SPI Bus/Device device drivers"
        select RT_USING_DEVICE
        default n
    
        if RT_USING_SPI
            if RT_HAVING_SPI_MSD
                config RT_USING_SPI_MSD
                    bool "Using SD/TF card driver with spi"
                    select RT_USING_DFS
                    default n
            endif
            
            if RT_HAVING_SFUD
                config RT_USING_SFUD
                    bool "Using Serial Flash Universal Driver"
                    default n
                    if RT_USING_SFUD            
                        config RT_SFUD_USING_SFDP
                        bool "Using auto probe flash JEDEC SFDP parameter"
                        default y
                        
                        config RT_SFUD_USING_FLASH_INFO_TABLE
                        bool "Using defined supported flash chip information table"
                        default y
                        
                        config RT_DEBUG_SFUD
                        bool "Show more SFUD debug information"
                        default n
                    endif
            endif
        
            if RT_HAVING_W25QXX
                config RT_USING_W25QXX
                    bool "Using W25QXX SPI NorFlash"
                    default n
            endif
    
            if RT_HAVING_GD
                config RT_USING_GD
                    bool "Using GD SPI NorFlash"
                    default n
            endif
    
            if RT_HAVING_ENC28J60
                config RT_USING_ENC28J60
                    bool "Using ENC28J60 SPI Ethernet network interface"
                    select RT_USING_LWIP
                    default n
            endif

            if RT_HAVING_SPI_WIFI
                config RT_USING_SPI_WIFI
                    bool "Using RW009/007 SPI Wi-Fi wireless interface"
                    select RT_USING_LWIP
                    default n
            endif
        endif
endif

if RT_HAVING_WDT
    config RT_USING_WDT
        bool "Using Watch Dog device drivers"
        select RT_USING_DEVICE
        default n
endif

if RT_HAVING_WIFI
    config RT_USING_WIFI
        bool "Using Wi-Fi network"
        select RT_USING_DEVICE
        default n
    
        if RT_USING_WIFI
            config RT_USING_WLAN_STA
                bool "Using station mode"
                default y
    
            config RT_USING_WLAN_AP
                bool "Using ap mode"
                default n
    
            config WIFI_DEVICE_STA_NAME
                string "the wifi device name for station"
                default "w0"
    
            config WIFI_DEVICE_AP_NAME
                string "the wifi device name for ap"
                default "ap"
        endif
endif

endmenu
```

## code/rt-thread/components/libc/Kconfig
```kconfig
menu "POSIX layer and C standard library"

config RT_USING_LIBC
    bool "Enable libc APIs from toolchain"
    select RT_USING_MINILIBC
    default y
    
    if RT_USING_LIBC
    config RT_USING_MINILIBC
        bool "Enable minilibc"
        default y
    endif

if RT_USING_LIBC && RT_USING_DFS
    config RT_USING_POSIX
        bool "Enable POSIX layer for poll/select, stdin etc"
        select RT_USING_DFS_DEVFS
        select RT_USING_DEVICE_IPC
        default y

    if RT_USING_POSIX
    config RT_USING_POSIX_AIO
        bool "Enable AIO"
        default n
    endif
endif

endmenu
```
